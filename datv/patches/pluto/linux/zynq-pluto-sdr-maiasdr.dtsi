/*
 * ZYNQ Pluto SDR (Z7010/AD9363) - Maia SDR
 *
 * Copyright (C) 2022 Daniel Estevez <daniel@destevez.net>
 *
 * Licensed under the GPL-2.
*/

&fpga_axi {
        

        cf-ad9361-lpc@79020000 {
               
                /delete-property/ adi,axi-decimation-core-available;
        };

        
};

